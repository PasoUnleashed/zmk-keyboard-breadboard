## boards/shields/breadboard/Kconfig.defconfig
```kconfig
# Copyright (c) 2021 The ZMK Contributors
# SPDX-License-Identifier: MIT

if BREADBOARD

config ZMK_KEYBOARD_NAME
    default "breadboard"

endif
```

## boards/shields/breadboard/Kconfig.shield
```kconfig
# Copyright (c) 2021 The ZMK Contributors
# SPDX-License-Identifier: MIT

config BREADBOARD
    def_bool $(shields_list_contains,breadboard)
```
